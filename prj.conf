## CMakeLists.txt
```
cmake_minimum_required(VERSION 3.20.0)
find_package(Zephyr REQUIRED HINTS $ENV{ZEPHYR_BASE})

project(lsm6dsv16b)

target_sources(app PRIVATE src/main.c src/twim.c src/lsm6dsv16b.c)
```

## prj.conf
```kconfig
CONFIG_I2C=y
CONFIG_LOG=y
CONFIG_LOG_PROCESS_THREAD_SLEEP_MS=100
CONFIG_DK_LIBRARY=y
CONFIG_SETTINGS=y
```

## nrf52840dk_nrf52840.overlay
```dts
// To get started, press Ctrl+Space to bring up the completion menu and view the available nodes.

// You can also use the buttons in the sidebar to perform actions on nodes.
// Actions currently available include:

// * Enabling / disabling the node
// * Adding the bus to a bus
// * Removing the node
// * Connecting ADC channels

// For more help, browse the DeviceTree documentation at https://docs.zephyrproject.org/latest/guides/dts/index.html
// You can also visit the nRF DeviceTree extension documentation at https://docs.nordicsemi.com/bundle/nrf-connect-vscode/page/guides/ncs_configure_app.html#devicetree-support-in-the-extension

&i2c0 {
	clock-frequency = <I2C_BITRATE_STANDARD>;
	compatible = "nordic,nrf-twim";
};
```

## src/main.c
```c
#include <dk_buttons_and_leds.h>
#include <zephyr/kernel.h>
#include <zephyr/drivers/i2c.h>
#include <zephyr/logging/log.h>
#include <zephyr/settings/settings.h>
#include "twim.h"
#include "lsm6dsv16b.h"

LOG_MODULE_REGISTER(main, LOG_LEVEL_INF);

// Semaphore
K_SEM_DEFINE(sem_sensor, 0, 1);

// Device
const struct device *dev_twim0 = DEVICE_DT_GET(DT_NODELABEL(i2c0));


static void read_sensor_work_thread(void)
{
	int err;
	uint8_t twim_buffer[16];
	int16_t accel[3], gyro[3];

	while (true) {
		k_sem_take(&sem_sensor, K_FOREVER);

		// Read IMU sensor(s)
		err = twim_read(dev_twim0, LSM6DSV16B_ADDR1, OUTX_L_G, twim_buffer, 12);
		if (!err) {
			accel[0] = (int16_t)(twim_buffer[11] << 8) | twim_buffer[10];
			accel[1] = (int16_t)(twim_buffer[9] << 8) | twim_buffer[8];
			accel[2] = (int16_t)(twim_buffer[7] << 8) | twim_buffer[6];
			gyro[0] = (int16_t)(twim_buffer[1] << 8) | twim_buffer[0];
			gyro[1] = (int16_t)(twim_buffer[3] << 8) | twim_buffer[2];
			gyro[2] = (int16_t)(twim_buffer[5] << 8) | twim_buffer[4];

			// Display value(s) for debug
			LOG_INF("LSM6DSV16B ACC XYZ = %+6d, %+6d, %+6d", accel[0], accel[1], accel[2]);
			LOG_INF("LSM6DSV16B GYR XYZ = %+6d, %+6d, %+6d", gyro[0], gyro[1], gyro[2]);
		} else {
			LOG_ERR("Failed to read from IMU sensor.(%d)", err);
		}
	}
}
K_THREAD_DEFINE(read_sensor, 1024, read_sensor_work_thread, NULL, NULL, NULL, K_PRIO_PREEMPT(0), 0, 0);

/* ----- Timer Function Start ----- */
static void timer_stop_handler(struct k_timer *timer)
{
	LOG_INF("Timer stopped.");
}

static void timer_handler(struct k_timer *timer)
{
	// Resume thread
	LOG_DBG("Read sensor(s).");
	k_sem_give(&sem_sensor);
}
K_TIMER_DEFINE(timer, timer_handler, timer_stop_handler);
/* ----- Timer Function End ----- */

int main(void)
{
	int err;

	// Initialize LEDs
	err = dk_leds_init();
	if (err) {
		LOG_ERR("Cannot init LEDs.(%d)", err);
		return -1;
	}

	// Initialize
	if (LSM6DSV16B_init(dev_twim0, LSM6DSV16B_ADDR1)) {
		LOG_INF("IMU sensor has been initialized.");
	} else {
		LOG_ERR("Failed to initialize IMU sensor.(%d)", err);
		return -1;
	}

	// Timer
	k_timer_start(&timer, K_NO_WAIT, K_MSEC(1000));

	// Main
	while (true) {
		dk_set_led_on(0);
		k_msleep(500);
		dk_set_led_off(0);
		k_msleep(500);
		dk_set_led_on(1);
		k_msleep(500);
		dk_set_led_off(1);
		k_msleep(500);
	}
}
```

## src/lsm6dsv16b.c
```c
#include "lsm6dsv16b.h"

LOG_MODULE_REGISTER(lsm6dsv16b, LOG_LEVEL_NONE);

#if defined(CONFIG_I2C)
bool LSM6DSV16B_init(const struct device *dev, uint8_t device_addr)
{
	const uint8_t INIT_CMD[] = {
		CTRL1,
		CTRL2,
		CTRL6,
		CTRL8,
	};
	const uint8_t INIT_PARAM[] = {
		CTRL1_OP_MODE_XL_LP1 | CTRL1_ODR_XL_240HZ,
		CTRL2_OP_MODE_G_LP | CTRL2_ODR_G_240HZ,
		CTRL6_FS_G_2000DPS,
		CTRL8_FS_XL_16G,
	};
	int err;
	uint8_t twim_buffer[16] = {0};

	// Check IMU sensor
	err = twim_read(dev, device_addr, WHO_AM_I, twim_buffer, 1);
	if (err < 0) {
		LOG_ERR("Device cannot be found.(%d)", err);
		return false;
	} else if (twim_buffer[0] != I_AM_LSM6DSV16B) {
		LOG_ERR("This device is not LSM6DSV16B.");
		return false;
	}

	// Send
	for (uint8_t i = 0; i < sizeof(INIT_CMD); i++) {
		twim_buffer[0] = INIT_PARAM[i];
		err = twim_write(dev, device_addr, INIT_CMD[i], twim_buffer, 1);
		if (err < 0) {
			LOG_ERR("TWIM Error!(%d)", err);
			return false;
		}
	}
	return true;
}
#endif
```

## src/lsm6dsv16b.h
```c
#include "twim.h"

bool LSM6DSV16B_init(const struct device *dev, uint8_t device_addr);

// I2C Device Addresses
#define LSM6DSV16B_ADDR0			(0x6A)
#define LSM6DSV16B_ADDR1			(0x6B)

// Register(s)
#define FUNC_CFG_ACCESS				(0x01)
#define PIN_CTRL					(0x02)
#define IF_CFG						(0x03)
#define FIFO_CTRL1					(0x07)
#define FIFO_CTRL2					(0x08)
#define FIFO_CTRL3					(0x09)
#define FIFO_CTRL4					(0x0A)
#define COUNTER_BDR_REG1			(0x0B)
#define COUNTER_BDR_REG2			(0x0C)
#define INT1_CTRL					(0x0D)
#define INT2_CTRL					(0x0E)
#define WHO_AM_I					(0x0F)
#define CTRL1						(0x10)
#define CTRL2						(0x11)
#define CTRL3						(0x12)
#define CTRL4						(0x13)
#define CTRL5						(0x14)
#define CTRL6						(0x15)
#define CTRL7						(0x16)
#define CTRL8						(0x17)
#define CTRL9						(0x18)
#define CTRL10						(0x19)
#define CTRL_STATUS					(0x1A)
#define FIFO_STATUS1				(0x1B)
#define FIFO_STATUS2				(0x1C)
#define ALL_INT_SRC					(0x1D)
#define STATUS_REG					(0x1E)
#define OUT_TEMP_L					(0x20)
#define OUT_TEMP_H					(0x21)
#define OUTX_L_G					(0x22)
#define OUTX_H_G					(0x23)
#define OUTY_L_G					(0x24)
#define OUTY_H_G					(0x25)
#define OUTZ_L_G					(0x26)
#define OUTZ_H_G					(0x27)
#define OUTZ_L_A					(0x28)
#define OUTZ_H_A					(0x29)
#define OUTY_L_A					(0x2A)
#define OUTY_H_A					(0x2B)
#define OUTX_L_A					(0x2C)
#define OUTX_H_A					(0x2D)
#define UI_OUTZ_L_A_DualC			(0x34)
#define UI_OUTZ_H_A_DualC			(0x35)
#define UI_OUTY_L_A_DualC			(0x36)
#define UI_OUTY_H_A_DualC			(0x37)
#define UI_OUTX_L_A_DualC			(0x38)
#define UI_OUTX_H_A_DualC			(0x39)
#define TIMESTAMP0					(0x40)
#define TIMESTAMP1					(0x41)
#define TIMESTAMP2					(0x42)
#define TIMESTAMP3					(0x43)
#define WAKE_UP_SRC					(0x45)
#define TAP_SRC						(0x46)
#define D6D_SRC						(0x47)
#define EMB_FUNC_STATUS_MAINPAGE	(0x49)
#define FSM_STATUS_MAINPAGE			(0x4A)
#define INTERNAL_FREQ_FINE			(0x4F)
#define FUNCTIONS_ENABLE			(0x50)
#define INACTIVITY_DUR				(0x54)
#define INACTIVITY_THS				(0x55)
#define TAP_CFG0					(0x56)
#define TAP_CFG1					(0x57)
#define TAP_CFG2					(0x58)
#define TAP_THS_6D					(0x59)
#define TAP_DUR						(0x5A)
#define WAKE_UP_THS					(0x5B)
#define WAKE_UP_DUR					(0x5C)
#define FREE_FALL					(0x5D)
#define MD1_CFG						(0x5E)
#define MD2_CFG						(0x5F)
#define EMB_FUNC_CFG				(0x63)
#define TDM_CFG0					(0x6C)
#define TDM_CFG1					(0x6D)
#define TDM_CFG2					(0x6E)
#define Z_OFS_USR					(0x73)
#define Y_OFS_USR					(0x74)
#define X_OFS_USR					(0x75)
#define FIFO_DATA_OUT_TAG			(0x78)
#define FIFO_DATA_OUT_BYTE_0		(0x79)
#define FIFO_DATA_OUT_BYTE_1		(0x7A)
#define FIFO_DATA_OUT_BYTE_2		(0x7B)
#define FIFO_DATA_OUT_BYTE_3		(0x7C)
#define FIFO_DATA_OUT_BYTE_4		(0x7D)
#define FIFO_DATA_OUT_BYTE_5		(0x7E)

// Value(s)
#define I_AM_LSM6DSV16B				(0x71)
#define CTRL1_OP_MODE_XL_LP3		(0x60)
#define CTRL1_OP_MODE_XL_LP2		(0x50)
#define CTRL1_OP_MODE_XL_LP1		(0x40)
#define CTRL1_OP_MODE_XL_HP_TDM		(0x20)
#define CTRL1_OP_MODE_XL_HP			(0x00)
#define CTRL1_ODR_XL_7680HZ			(0x0C)
#define CTRL1_ODR_XL_3840HZ			(0x0B)
#define CTRL1_ODR_XL_1920HZ			(0x0A)
#define CTRL1_ODR_XL_960HZ			(0x09)
#define CTRL1_ODR_XL_480HZ			(0x08)
#define CTRL1_ODR_XL_240HZ			(0x07)
#define CTRL1_ODR_XL_120HZ			(0x06)
#define CTRL1_ODR_XL_60HZ			(0x05)
#define CTRL1_ODR_XL_30HZ			(0x04)
#define CTRL1_ODR_XL_15HZ			(0x03)
#define CTRL1_ODR_XL_7_5HZ			(0x02)
#define CTRL1_ODR_XL_1_875HZ		(0x01)
#define CTRL1_ODR_XL_PD				(0x00)
#define CTRL2_OP_MODE_G_LP			(0x50)
#define CTRL2_OP_MODE_G_SLEEP		(0x40)
#define CTRL2_OP_MODE_G_HP			(0x00)
#define CTRL2_ODR_G_7680HZ			(0x0C)
#define CTRL2_ODR_G_3840HZ			(0x0B)
#define CTRL2_ODR_G_1920HZ			(0x0A)
#define CTRL2_ODR_G_960HZ			(0x09)
#define CTRL2_ODR_G_480HZ			(0x08)
#define CTRL2_ODR_G_240HZ			(0x07)
#define CTRL2_ODR_G_120HZ			(0x06)
#define CTRL2_ODR_G_60HZ			(0x05)
#define CTRL2_ODR_G_30HZ			(0x04)
#define CTRL2_ODR_G_15HZ			(0x03)
#define CTRL2_ODR_G_7_5HZ			(0x02)
#define CTRL2_ODR_G_PD				(0x00)
#define CTRL3_BOOT					(0x80)
#define CTRL3_BDU					(0x40)
#define CTRL3_IF_INC				(0x04)
#define CTRL3_SW_RESET				(0x01)
#define CTRL6_LPF1_G_BW_7			(0x70)
#define CTRL6_LPF1_G_BW_6			(0x60)
#define CTRL6_LPF1_G_BW_5			(0x50)
#define CTRL6_LPF1_G_BW_4			(0x40)
#define CTRL6_LPF1_G_BW_3			(0x30)
#define CTRL6_LPF1_G_BW_2			(0x20)
#define CTRL6_LPF1_G_BW_1			(0x10)
#define CTRL6_LPF1_G_BW_0			(0x00)
#define CTRL6_FS_G_4000DPS			(0x0C)
#define CTRL6_FS_G_2000DPS			(0x04)
#define CTRL6_FS_G_1000DPS			(0x03)
#define CTRL6_FS_G_500DPS			(0x02)
#define CTRL6_FS_G_250DPS			(0x01)
#define CTRL6_FS_G_125DPS			(0x00)
#define CTRL7_LPF1_G_EN				(0x01)
#define CTRL8_HP_LPF2_XL_BW_LP_DIV800	(0xE0)
#define CTRL8_HP_LPF2_XL_BW_LP_DIV400	(0xC0)
#define CTRL8_HP_LPF2_XL_BW_LP_DIV200	(0xA0)
#define CTRL8_HP_LPF2_XL_BW_LP_DIV100	(0x80)
#define CTRL8_HP_LPF2_XL_BW_LP_DIV45	(0x60)
#define CTRL8_HP_LPF2_XL_BW_LP_DIV20	(0x40)
#define CTRL8_HP_LPF2_XL_BW_LP_DIV10	(0x20)
#define CTRL8_HP_LPF2_XL_BW_LP_DIV4	(0x00)
#define CTRL8_XL_DualC_EN			(0x08)
#define CTRL8_FS_XL_16G				(0x03)
#define CTRL8_FS_XL_8G				(0x02)
#define CTRL8_FS_XL_4G				(0x01)
#define CTRL8_FS_XL_2G				(0x00)
#define CTRL9_HP_REF_MODE_XL		(0x40)
#define CTRL9_XL_FASTSETTL_MODE		(0x20)
#define CTRL9_HP_SLOPE_XL_EN		(0x10)
#define CTRL9_LPF2_XL_EN			(0x08)
#define CTRL9_USR_OFF_W				(0x02)
#define CTRL9_USR_OFF_ON_OUT		(0x01)
```

## src/twim.c
```c
#include "twim.h"

LOG_MODULE_REGISTER(twim, LOG_LEVEL_INF);


#if defined(CONFIG_I2C)
int twim_write(const struct device *dev, uint8_t addr, uint8_t reg, uint8_t *data, uint32_t num_bytes)
{
	int err;
	struct i2c_msg msgs[2];

	/* Send the address to write to */
	msgs[0].buf = &reg;
	msgs[0].len = 1U;
	msgs[0].flags = I2C_MSG_WRITE;

	/* Data to be written, and STOP after this. */
	msgs[1].buf = data;
	msgs[1].len = num_bytes;
	msgs[1].flags = I2C_MSG_WRITE | I2C_MSG_STOP;

	err = i2c_transfer(dev, &msgs[0], 2, addr);
	return err;
}

int twim_write_noreg(const struct device *dev, uint8_t addr, uint8_t *data, uint32_t num_bytes)
{
	int err;
	struct i2c_msg msgs;

	/* Data to be written, and STOP after this. */
	msgs.buf = data;
	msgs.len = num_bytes;
	msgs.flags = I2C_MSG_WRITE | I2C_MSG_STOP;

	err = i2c_transfer(dev, &msgs, 1, addr);
	return err;
}

int twim_read(const struct device *dev, uint8_t addr, uint8_t reg, uint8_t *data, uint32_t num_bytes)
{
	int err;
	struct i2c_msg msgs[2];

	/* Send the address to read from */
	msgs[0].buf = &reg;
	msgs[0].len = 1U;
	msgs[0].flags = I2C_MSG_WRITE;

	/* Read from device. STOP after this. */
	msgs[1].buf = data;
	msgs[1].len = num_bytes;
	msgs[1].flags = I2C_MSG_READ | I2C_MSG_STOP;

	err = i2c_transfer(dev, &msgs[0], 2, addr);
	return err;
}

int twim_read_noreg(const struct device *dev, uint8_t addr, uint8_t *data, uint32_t num_bytes)
{
	int err;
	struct i2c_msg msgs;

	/* Read from device. STOP after this. */
	msgs.buf = data;
	msgs.len = num_bytes;
	msgs.flags = I2C_MSG_READ | I2C_MSG_STOP;

	err = i2c_transfer(dev, &msgs, 1, addr);
	return err;
}
#endif
```

## src/twim.h
```c
#include <zephyr/drivers/i2c.h>
#include <zephyr/kernel.h>
#include <zephyr/logging/log.h>


int twim_write(const struct device *dev, uint8_t addr, uint8_t reg, uint8_t *data, uint32_t num_bytes);
int twim_write_noreg(const struct device *dev, uint8_t addr, uint8_t *data, uint32_t num_bytes);
int twim_read(const struct device *dev, uint8_t addr, uint8_t reg, uint8_t *data, uint32_t num_bytes);
int twim_read_noreg(const struct device *dev, uint8_t addr, uint8_t *data, uint32_t num_bytes);
```
